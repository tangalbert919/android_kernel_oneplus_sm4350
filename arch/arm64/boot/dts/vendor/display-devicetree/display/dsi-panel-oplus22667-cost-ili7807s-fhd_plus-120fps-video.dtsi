&mdss_mdp {
	dsi_oplus22667_cost_ili7807s_fhd_plus_120fps_video: qcom,mdss_dsi_oplus22667_cost_ili7807s_fhd_plus_120fps_video {
		qcom,mdss-dsi-panel-name =
			"cost ili7807s 22667 fhd plus mipi panel with DSC";
		qcom,mdss-dsi-panel-type = "dsi_video_mode";
		qcom,dsi-ctrl-num = <0>;
		qcom,dsi-phy-num = <0>;
		qcom,mdss-dsi-virtual-channel-id = <0>;
		qcom,mdss-dsi-stream = <0>;
		qcom,mdss-dsi-bpp = <24>;
		qcom,mdss-dsi-color-order = "rgb_swap_rgb";
		qcom,mdss-dsi-underflow-color = <0xff>;
		qcom,mdss-dsi-border-color = <0>;

		qcom,mdss-dsi-traffic-mode = "burst_mode";
		qcom,mdss-dsi-bllp-power-mode;
		qcom,mdss-dsi-bllp-eof-power-mode;
		qcom,mdss-dsi-lane-0-state;
		qcom,mdss-dsi-lane-1-state;
		qcom,mdss-dsi-lane-2-state;
		qcom,mdss-dsi-lane-3-state;
		qcom,mdss-dsi-dma-trigger = "trigger_sw";
		qcom,mdss-dsi-mdp-trigger = "none";
		qcom,mdss-dsi-reset-sequence = <1 5>, <0 5>, <1 5>;
		qcom,platform-reset-gpio-always-on;

		qcom,mdss-dsi-wr-mem-start = <0x2C>;
		qcom,mdss-dsi-wr-mem-continue = <0x3C>;

		qcom,bl-update-flag = "delay_until_first_frame";
		qcom,mdss-dsi-init-delay-us = <1000>;
		qcom,mdss-dsi-lp11-init;
		qcom,ulps-enabled;
		qcom,suspend-ulps-enabled;

		qcom,mdss-dsi-te-pin-select = <1>;
		qcom,mdss-dsi-te-dcs-command = <1>;
		qcom,mdss-dsi-te-check-enable;
		qcom,mdss-dsi-te-using-te-pin;

		qcom,mdss-pan-physical-width-dimension = <68>;
		qcom,mdss-pan-physical-height-dimension = <153>;

		qcom,mdss-dsi-display-timings {
			timing@0 {
				//qcom,mdss-mdp-transfer-time-us = <7000>;
				qcom,mdss-dsi-panel-framerate = <120>;
				qcom,mdss-dsi-panel-width = <1080>;
				qcom,mdss-dsi-panel-height = <2400>;
				qcom,mdss-dsi-h-front-porch = <22>;
				qcom,mdss-dsi-h-back-porch = <22>;
				qcom,mdss-dsi-h-pulse-width = <4>;
				qcom,mdss-dsi-h-sync-skew = <0>;
				qcom,mdss-dsi-v-back-porch = <40>;
				qcom,mdss-dsi-v-front-porch = <40>;
				qcom,mdss-dsi-v-pulse-width = <4>;
				qcom,mdss-dsi-on-command = [
					39 01 00 00 00 00 04 FF 78 07 06
					15 01 00 00 00 00 02 08 20
					39 01 00 00 00 00 04 FF 78 07 03
					15 01 00 00 00 00 02 84 01
					39 01 00 00 00 00 04 FF 78 07 00
					15 01 00 00 00 00 02 53 24
					15 01 00 00 00 00 02 35 00
					05 01 00 00 78 00 01 11
					05 01 00 00 14 00 01 29
				];
				qcom,oplus-mdss-dsi-on-command = [
					39 01 00 00 00 00 04 FF 78 07 06
					15 01 00 00 00 00 02 08 20
					39 01 00 00 00 00 04 FF 78 07 03
					15 01 00 00 00 00 02 84 01
					39 01 00 00 00 00 04 FF 78 07 00
					15 01 00 00 00 00 02 53 24
					15 01 00 00 00 00 02 35 00
					05 01 00 00 78 00 01 11
					05 01 00 00 14 00 01 29
				];
				qcom,mdss-dsi-off-command = [
					39 01 00 00 01 00 04 FF 78 07 00
					05 01 00 00 14 00 01 28
					05 01 00 00 53 00 01 10
				];
				qcom,mdss-dsi-post-panel-on-command =[
					39 01 00 00 00 00 04 FF 78 07 00
				];
				qcom,mdss-dsi-cabc-off-command = [
					39 01 00 00 00 00 04 FF 78 07 00
					15 01 00 00 00 00 02 55 00
				];
				qcom,mdss-dsi-cabc-ui-command = [
					39 01 00 00 00 00 04 FF 78 07 00
					15 01 00 00 00 00 02 55 01
				];
				qcom,mdss-dsi-cabc-still-image-command = [
					39 01 00 00 00 00 04 FF 78 07 00
					15 01 00 00 00 00 02 55 02
				];
				qcom,mdss-dsi-cabc-video-command = [
					39 01 00 00 00 00 04 FF 78 07 00
					15 01 00 00 00 00 02 55 03
				];
				qcom,mdss-dsi-backlight-gamma-enter-command = [
					39 01 00 00 00 00 04 FF 78 07 08
					39 01 00 00 00 00 20 E0 15 56 5A 60 15 6D 7B 87 15 9C AD CF 29 ED 1C 4C 2A 7A B6 DC 3F 0C 33 56 3F 6F 91 BC 0F D8 D9
					39 01 00 00 00 00 20 E1 15 56 5A 60 15 6D 7B 87 15 9C AD CF 29 ED 1C 4C 2A 7A B6 DC 3F 0C 33 56 3F 6F 91 BC 0F D8 D9
					39 01 00 00 00 00 04 FF 78 07 00
				];
				qcom,mdss-dsi-backlight-gamma-exit-command = [
					39 01 00 00 00 00 04 FF 78 07 08
					39 01 00 00 00 00 20 E0 00 00 1D 4A 00 8A B7 DB 15 13 3C 7D 25 AA F3 29 2A 60 9E C5 3E F8 1C 48 3F 60 85 B5 0F D7 D9
					39 01 00 00 00 00 20 E1 00 00 1D 4A 00 8A B7 DB 15 13 3C 7D 25 AA F3 29 2A 60 9E C5 3E F8 1C 48 3F 60 85 B5 0F D7 D9
					39 01 00 00 00 00 04 FF 78 07 00
				];

				qcom,mdss-dsi-on-command-state = "dsi_lp_mode";
				qcom,oplus-mdss-dsi-on-command-state = "dsi_lp_mode";
				qcom,mdss-dsi-off-command-state = "dsi_lp_mode";
				qcom,mdss-dsi-post-panel-on-command-state="dsi_lp_mode";
				qcom,mdss-dsi-cabc-off-command-state = "dsi_lp_mode";
				qcom,mdss-dsi-cabc-ui-command-state = "dsi_lp_mode";
				qcom,mdss-dsi-cabc-still-image-command-state = "dsi_lp_mode";
				qcom,mdss-dsi-cabc-video-command-state = "dsi_lp_mode";
				qcom,mdss-dsi-backlight-gamma-enter-command-state = "dsi_hs_mode";
				qcom,mdss-dsi-backlight-gamma-exit-command-state = "dsi_hs_mode";

				qcom,compression-mode = "dsc";
				qcom,mdss-dsc-slice-height = <8>;
				qcom,mdss-dsc-slice-width = <540>;
				qcom,mdss-dsc-slice-per-pkt = <2>;
				qcom,mdss-dsc-bit-per-component = <8>;
				qcom,mdss-dsc-bit-per-pixel = <8>;
				qcom,mdss-dsc-block-prediction-enable;
			};
		};
	};
};

&dsi_oplus22667_cost_ili7807s_fhd_plus_120fps_video {
	oplus,mdss-dsi-manufacture = "dsjm";
	oplus,mdss-dsi-vendor-name = "JDI_ILI7807S";
	oplus,mdss-dsi-pre-bl-delay-enabled;
	oplus,mdss-dsi-pre-bl-delay-ms = <30>;
	oplus,mdss-dsi-cabc-enabled;
	oplus,mdss-dsi-gamma-switch-enabled;
	oplus,mdss-dsi-lp-config-flag;
	oplus,lcd_switch_enabled;
	oplus,dfps-idle-off;
	qcom,panel-supply-entries = <&dsi_panel_pwr_supply_labibb>;
	qcom,mdss-dsi-bl-pmic-control-type = "bl_ctrl_dcs";
	qcom,mdss-dsi-bl-min-level = <13>;
	qcom,mdss-dsi-bl-max-level = <4095>;
	qcom,mdss-brightness-max-level = <4095>;
	qcom,mdss-dsi-bl-normal-max-level = <3630>;
	qcom,mdss-brightness-normal-max-level = <3630>;
	qcom,mdss-brightness-default-level = <891>;
	qcom,platform-te-gpio = <&tlmm 23 0>;
	qcom,platform-reset-gpio = <&tlmm 100 0>;
	qcom,dsi-select-clocks = "mux_byte_clk0", "mux_pixel_clk0",
		"src_byte_clk0", "src_pixel_clk0",
		"shadow_byte_clk0", "shadow_pixel_clk0";

	qcom,esd-check-enabled;
	qcom,mdss-dsi-panel-status-check-mode = "reg_read";
	qcom,mdss-dsi-panel-status-command = [06 01 00 01 00 00 01 09];
	qcom,mdss-dsi-panel-status-command-state = "dsi_lp_mode";
	qcom,mdss-dsi-panel-status-value = <0x80 0x03 0x06>;
	qcom,mdss-dsi-panel-status-read-length = <3>;

	qcom,mdss-dsi-pan-enable-dynamic-fps;
	qcom,mdss-dsi-pan-fps-update = "dfps_immediate_porch_mode_vfp";
	qcom,dsi-supported-dfps-list = <120 90 60 50 48 30>;
	qcom,mdss-dsi-qsync-min-refresh-rate = <30>;

	//qcom,dsi-dyn-clk-enable;
	//qcom,dsi-dyn-clk-type = "constant-fps-adjust-hfp";
	//qcom,dsi-dyn-clk-list = <1107046080 1117009376>;

	oplus,dsi-brightness-remapping = <21    0>,
            <22    13>,
            <246   60>,
            <688   120>,
            <920   190>,
            <1096  280>,
            <1244  398>,
            <1373  484>,
            <1489  578>,
            <1596  673>,
            <1694  767>,
            <1786  862>,
            <1872  956>,
            <1954  1051>,
            <2032  1145>,
            <2107  1240>,
            <2178  1334>,
            <2247  1429>,
            <2313  1523>,
            <2377  1618>,
            <2440  1712>,
            <2500  1807>,
            <2559  1901>,
            <2616  1996>,
            <2671  2090>,
            <2725  2185>,
            <2778  2279>,
            <2830  2374>,
            <2881  2468>,
            <2930  2563>,
            <2979  2657>,
            <3027  2752>,
            <3074  2846>,
            <3119  2941>,
            <3165  3035>,
            <3209  3130>,
            <3253  3224>,
            <3630  3630>,
            <4095  4095>;

	qcom,mdss-dsi-t-clk-post = <0x0B>;
	qcom,mdss-dsi-t-clk-pre = <0x16>;
	qcom,mdss-dsi-display-timings {
		timing@0 {
			qcom,mdss-dsi-panel-phy-timings = [00 1A 06 06 16 14 07
				06 07 02 04 00 16 0B];
			qcom,display-topology = <1 1 1>;
			qcom,default-topology-index = <0>;
		};
	};
};

&dsi_oplus22667_cost_ili7807s_fhd_plus_120fps_video {
	qcom,panel_voltage_vddi_name = "vddio";
	qcom,panel_voltage_vddi = <0 1650000 1800000 1950000>;
	qcom,panel_voltage_vddr_name = "vddio";
	qcom,panel_voltage_vddr = <1 1650000 1800000 1950000>;
};

